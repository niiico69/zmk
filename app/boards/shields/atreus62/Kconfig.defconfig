## app/boards/shields/atreus62/Kconfig.defconfig
```kconfig
# Copyright (c) 2020 The ZMK Contributors
# SPDX-License-Identifier: MIT

if SHIELD_ATREUS62

config ZMK_KEYBOARD_NAME
    default "Atreus62"

endif
```

## app/boards/shields/atreus62/Kconfig.shield
```kconfig
# Copyright (c) 2020 The ZMK Contributors
# SPDX-License-Identifier: MIT

config SHIELD_ATREUS62
    def_bool $(shields_list_contains,atreus62)
```
